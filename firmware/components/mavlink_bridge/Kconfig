## firmware/components/mavlink_bridge/Kconfig
```kconfig
menu "MAVLink Bridge"

    config MAVLINK_UART_NUM
        int "UART peripheral number"
        default 1
        range 0 2
        help
            UART peripheral used for the MAVLink connection to the flight
            controller.  UART0 is usually reserved for the console log.

    config MAVLINK_UART_TX_PIN
        int "TX GPIO pin"
        default 21
        help
            GPIO pin for UART TX to the flight controller (→ H743 RX4).

    config MAVLINK_UART_RX_PIN
        int "RX GPIO pin"
        default 20
        help
            GPIO pin for UART RX from the flight controller (← H743 TX4).

    config MAVLINK_UART_BAUD
        int "Baud rate"
        default 921600
        help
            Baud rate for the MAVLink UART link.  Must match ArduCopter
            SERIAL6_BAUD (921 = 921600).

endmenu
```

## firmware/components/ov2640/Kconfig
```kconfig
menu "OV2640 Camera Driver"

    config OV2640_JPEG_QUALITY
        int "JPEG quality (0-63, lower is better)"
        default 12
        range 0 63
        help
            JPEG compression quality. Lower values produce higher quality
            images but larger file sizes. 12 is a good balance for
            compressed image streaming over micro-ROS UDP transport.

    choice OV2640_FRAME_SIZE
        prompt "Frame resolution"
        default OV2640_FRAME_SIZE_QVGA
        help
            Camera capture resolution. Smaller resolutions reduce JPEG
            size and micro-ROS transport bandwidth. QVGA is the default
            as this camera is supplementary (NOT the primary SLAM sensor).

        config OV2640_FRAME_SIZE_QQVGA
            bool "QQVGA (160x120)"
        config OV2640_FRAME_SIZE_QVGA
            bool "QVGA (320x240)"
        config OV2640_FRAME_SIZE_CIF
            bool "CIF (400x296)"
        config OV2640_FRAME_SIZE_VGA
            bool "VGA (640x480)"
        config OV2640_FRAME_SIZE_SVGA
            bool "SVGA (800x600)"
    endchoice

    config OV2640_FB_COUNT
        int "Frame buffer count"
        default 2
        range 1 3
        help
            Number of frame buffers in PSRAM. 2 enables double-buffering
            so capture continues while the previous frame is transmitted.
            More buffers use more PSRAM but reduce frame drops.

endmenu
```

## firmware/components/tof_sensor/Kconfig
```kconfig
menu "ToF Sensor (VL53L8CX)"

    config TOF_SENSOR_COUNT
        int "Number of VL53L8CX sensors"
        default 4
        range 1 4
        help
            Number of VL53L8CX sensors on the shared I2C bus.
            Each sensor needs a unique LPn GPIO for address assignment.

    config TOF_I2C_SDA_GPIO
        int "I2C SDA GPIO"
        default 6
        help
            GPIO used for I2C data line (shared by all sensors).

    config TOF_I2C_SCL_GPIO
        int "I2C SCL GPIO"
        default 7
        help
            GPIO used for I2C clock line (shared by all sensors).

    config TOF_I2C_FREQ_HZ
        int "I2C clock frequency (Hz)"
        default 1000000
        help
            I2C bus speed. VL53L8CX supports up to 1 MHz (Fast Mode Plus).
            Reduce to 400000 if the bus is unstable with long wires.

    config TOF_LPN_GPIO_0
        int "LPn GPIO for sensor #0 (front)"
        default 2
        help
            Low-Power enable pin for sensor 0. Directly controls
            sensor power-up during the address assignment sequence.

    config TOF_LPN_GPIO_1
        int "LPn GPIO for sensor #1 (right)"
        default 3

    config TOF_LPN_GPIO_2
        int "LPn GPIO for sensor #2 (back)"
        default 4

    config TOF_LPN_GPIO_3
        int "LPn GPIO for sensor #3 (left)"
        default 5

    config TOF_RANGING_FREQ_HZ
        int "Ranging frequency (Hz)"
        default 15
        range 1 60
        help
            Sensor measurement rate. 15 Hz matches the micro-ROS
            publishing timer (66 ms period).

    config TOF_POLL_TASK_STACK
        int "Polling task stack size (bytes)"
        default 4096
        help
            Stack size for the FreeRTOS task that polls all sensors.

    config TOF_POLL_TASK_PRIORITY
        int "Polling task priority"
        default 5
        range 1 24
        help
            FreeRTOS priority for the sensor polling task.

endmenu
```

## firmware/main/Kconfig.projbuild
```kconfig
menu "Drone Swarm Config"

    config DRONE_ID
        int "Drone ID (1-255)"
        default 1
        range 1 255
        help
            Unique identifier for this drone in the swarm.
            Determines ROS 2 namespace: /drone_N/

endmenu
```

## firmware/sdkconfig.defaults
```kconfig
# sdkconfig.defaults — XIAO ESP32S3 Sense project defaults
# ============================================================
# *** BEFORE FIRST BUILD: change the two CHANGE_ME fields below. ***
# All other values match hardware/inventory.yaml and docs/hardware_wiring.md.
#
# Apply:
#   idf.py set-target esp32s3
#   idf.py build

# ------------------------------------------------------------
# WiFi credentials — CHANGE_ME before first build
# ------------------------------------------------------------
CONFIG_MICRO_ROS_WIFI_SSID="CHANGE_ME_SSID"
CONFIG_MICRO_ROS_WIFI_PASS="CHANGE_ME_PASSWORD"

# ------------------------------------------------------------
# micro-ROS — UDP transport to ground station agent
# DESIGN: UDP best-effort matches sensor QoS; reliable not needed here.
#         Agent IP must match the machine running `ros2 run micro_ros_agent`.
# ------------------------------------------------------------
CONFIG_MICRO_ROS_AGENT_IP="CHANGE_ME_AGENT_IP"
CONFIG_MICRO_ROS_AGENT_PORT=8888

# ------------------------------------------------------------
# Drone ID — unique per vehicle (1–255)
# ------------------------------------------------------------
CONFIG_DRONE_ID=1

# ------------------------------------------------------------
# Flash — 8 MB QIO (XIAO ESP32S3 Sense hardware)
# ------------------------------------------------------------
CONFIG_ESPTOOLPY_FLASHSIZE_8MB=y
CONFIG_ESPTOOLPY_FLASHMODE_QIO=y

# ------------------------------------------------------------
# PSRAM — 8 MB Octal SPI (OPI)
# ------------------------------------------------------------
CONFIG_SPIRAM=y
CONFIG_SPIRAM_MODE_OCT=y
CONFIG_SPIRAM_SPEED_80M=y

# ------------------------------------------------------------
# FreeRTOS — 1000 Hz tick rate required by micro-ROS timers
# DESIGN: micro-ROS timer queue needs 1 ms tick resolution.
#         Lower rates (100 Hz default) cause jitter in 15 Hz ToF publish.
# ------------------------------------------------------------
CONFIG_FREERTOS_HZ=1000
CONFIG_FREERTOS_UNICORE=n

# Main task stack (micro-ROS needs headroom)
CONFIG_ESP_MAIN_TASK_STACK_SIZE=8192

# ------------------------------------------------------------
# ToF sensors (4× VL53L8CX) — hardware/inventory.yaml GPIO assignments
# ------------------------------------------------------------
CONFIG_TOF_SENSOR_COUNT=4
CONFIG_TOF_I2C_SDA_GPIO=6
CONFIG_TOF_I2C_SCL_GPIO=7
CONFIG_TOF_I2C_FREQ_HZ=1000000
CONFIG_TOF_LPN_GPIO_0=2
CONFIG_TOF_LPN_GPIO_1=3
CONFIG_TOF_LPN_GPIO_2=4
CONFIG_TOF_LPN_GPIO_3=5
CONFIG_TOF_RANGING_FREQ_HZ=15

# ------------------------------------------------------------
# Camera (OV2640) — QVGA JPEG, supplementary telemetry only
# ------------------------------------------------------------
CONFIG_OV2640_FRAME_SIZE_QVGA=y
CONFIG_OV2640_JPEG_QUALITY=12
CONFIG_OV2640_FB_COUNT=2

# ------------------------------------------------------------
# MAVLink bridge — UART1, GPIO21/20, 921600 baud
# Matches H743-MINI V3 SERIAL6 (UART4) assignment in inventory.yaml.
# ------------------------------------------------------------
CONFIG_MAVLINK_UART_NUM=1
CONFIG_MAVLINK_UART_TX_PIN=21
CONFIG_MAVLINK_UART_RX_PIN=20
CONFIG_MAVLINK_UART_BAUD=921600

# ------------------------------------------------------------
# WiFi buffers — reliable UDP streaming for micro-ROS
# ------------------------------------------------------------
CONFIG_ESP_WIFI_STATIC_RX_BUFFER_NUM=16
CONFIG_ESP_WIFI_DYNAMIC_RX_BUFFER_NUM=64
CONFIG_ESP_WIFI_DYNAMIC_TX_BUFFER_NUM=64

# LWIP — micro-ROS UDP transport
CONFIG_LWIP_MAX_SOCKETS=16
CONFIG_LWIP_SO_RCVBUF=y

# ------------------------------------------------------------
# Partition table — larger app partition for micro-ROS binary
# ------------------------------------------------------------
CONFIG_PARTITION_TABLE_CUSTOM=y
CONFIG_PARTITION_TABLE_CUSTOM_FILENAME="partitions.csv"

# ------------------------------------------------------------
# Compiler
# ------------------------------------------------------------
CONFIG_COMPILER_OPTIMIZATION_PERF=y
```
